## configs/axc6700_defconfig
```kconfig
CONFIG_ARM=y
CONFIG_TARGET_AXXIA=y
CONFIG_TARGET_AXC6700=y
CONFIG_NET_ONCE=n
CONFIG_AXXIA_GPIO=y
CONFIG_AXXIA_SPI=y
CONFIG_SYS_MALLOC_F=y
CONFIG_SYS_MALLOC_F_LEN=0x2000
```
